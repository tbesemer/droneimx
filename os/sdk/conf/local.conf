## os/sdk/conf/local.conf
```bitbake
MACHINE = "wandboard"
DISTRO ?= "poky"
PACKAGE_CLASSES ?= "package_rpm"
PATCHRESOLVE = "noop"
BB_DISKMON_DIRS = "\
    STOPTASKS,${TMPDIR},1G,100K \
    STOPTASKS,${DL_DIR},1G,100K \
    STOPTASKS,${SSTATE_DIR},1G,100K \
    STOPTASKS,/tmp,100M,100K \
    ABORT,${TMPDIR},100M,1K \
    ABORT,${DL_DIR},100M,1K \
    ABORT,${SSTATE_DIR},100M,1K \
    ABORT,/tmp,10M,1K"
PACKAGECONFIG_append_pn-qemu-native = " sdl"
PACKAGECONFIG_append_pn-nativesdk-qemu = " sdl"
CONF_VERSION = "1"

EXTRA_IMAGE_FEATURES ?= "debug-tweaks tools-sdk tools-debug"
USER_CLASSES ?= "buildstats image-mklibs image-prelink"
ACCEPT_FSL_EULA = "1"

IMAGE_INSTALL_append += " libusb-compat libstdc++"

IMAGE_INSTALL_append += "gstreamer"
IMAGE_INSTALL_append += "strace"
IMAGE_INSTALL_append += "gdb"

PREFERRED_PROVIDER_jpeg ="libjepg-turbo"
PREFERRED_PROVIDER_jpeg-native ="libjepg-turbo-native"
IMAGE_INSTALL_append += "libjpeg-turbo"
```
